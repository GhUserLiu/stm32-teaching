/**
 * @file    ssd1306.c
 * @brief   SSD1306 OLED 驱动：软件 I2C + 128x64 帧缓冲 + 6x8 字库
 */
#include "ssd1306.h"
#include "board_f1.h"
#include "f1_delay.h"

/* ---------------- 软件 I2C ---------------- */
#define SCL_H() gpio_set(OLED_SCL_PORT, OLED_SCL_PIN)
#define SCL_L() gpio_reset(OLED_SCL_PORT, OLED_SCL_PIN)
#define SDA_H() gpio_set(OLED_SDA_PORT, OLED_SDA_PIN)
#define SDA_L() gpio_reset(OLED_SDA_PORT, OLED_SDA_PIN)
#define SDA_READ() gpio_read(OLED_SDA_PORT, OLED_SDA_PIN)

static void i2c_pins_init(void)
{
    RCC->APB2ENR |= RCC_APB2ENR_IOPB;
    gpio_init(OLED_SCL_PORT, OLED_SCL_PIN, GPIO_MODE_OUT_OD_2);
    gpio_init(OLED_SDA_PORT, OLED_SDA_PIN, GPIO_MODE_OUT_OD_2);
    SCL_H(); SDA_H();
}

static void i2c_delay(void) { delay_us(4); }   /* ~100kHz */

static int i2c_start(void)
{
    SDA_H(); SCL_H(); i2c_delay();
    SDA_L(); i2c_delay();
    SCL_L(); i2c_delay();
    return 0;
}

static void i2c_stop(void)
{
    SDA_L(); i2c_delay();
    SCL_H(); i2c_delay();
    SDA_H(); i2c_delay();
}

/* 返回 ACK(0)/NACK(1) */
static int i2c_write_byte(uint8_t b)
{
    for (int i = 7; i >= 0; i--) {
        if ((b >> i) & 1) SDA_H(); else SDA_L();
        i2c_delay();
        SCL_H(); i2c_delay();
        SCL_L(); i2c_delay();
    }
    /* 读 ACK：释放 SDA，给第 9 个时钟 */
    SDA_H(); i2c_delay();
    SCL_H(); i2c_delay();
    int ack = SDA_READ();
    SCL_L(); i2c_delay();
    return ack;
}

/* ---------------- SSD1306 命令/数据 ---------------- */
#define SSD1306_ADDR   0x3C        /* 7 位地址（写操作 <<1 = 0x78） */

static void ssd1306_cmd(uint8_t cmd)
{
    i2c_start();
    i2c_write_byte(SSD1306_ADDR << 1);
    i2c_write_byte(0x00);          /* Co=0 D/C#=0：命令 */
    i2c_write_byte(cmd);
    i2c_stop();
}

static uint8_t fb[SSD1306_HEIGHT / 8][SSD1306_WIDTH];   /* 8 页 x 128 列 */

void ssd1306_init(void)
{
    i2c_pins_init();
    delay_ms(100);                 /* 上电稳定 */

    static const uint8_t init_seq[] = {
        0xAE,             /* 显示关 */
        0x20, 0x00,       /* 水平寻址模式 */
        0xB0,             /* 页起始地址 0 */
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        0xAF,             /* 显示开 */
    };
    for (unsigned i = 0; i < sizeof(init_seq); i++)
        ssd1306_cmd(init_seq[i]);
}

void ssd1306_fill(uint8_t val)
{
    for (int p = 0; p < 8; p++)
        for (int x = 0; x < SSD1306_WIDTH; x++)
            fb[p][x] = val;
}

void ssd1306_clear(void) { ssd1306_fill(0x00); }

void ssd1306_flush(void)
{
    for (int p = 0; p < 8; p++) {
        ssd1306_cmd(0xB0 | (uint8_t)p);   /* 页地址 */
        ssd1306_cmd(0x00);                /* 列低 */
        ssd1306_cmd(0x10);                /* 列高 */
        i2c_start();
        i2c_write_byte(SSD1306_ADDR << 1);
        i2c_write_byte(0x40);             /* 数据 */
        for (int x = 0; x < SSD1306_WIDTH; x++)
            i2c_write_byte(fb[p][x]);
        i2c_stop();
    }
}

/* ---------------- 6x8 ASCII 字库（0x20~0x7E） ---------------- */
static const uint8_t font6x8[][6] = {
    {0x00,0x00,0x00,0x00,0x00,0x00}, /* 空格 */
    {0x00,0x00,0x5F,0x00,0x00,0x00}, /* ! */
    {0x00,0x07,0x00,0x07,0x00,0x00}, /* " */
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    {0x08,0x08,0x2A,0x1C,0x08,0x00}, /* ~ */
};

void ssd1306_char(uint8_t x, uint8_t page, char c)
{
    if (c < 0x20 || c > 0x7E) c = '?';
    const uint8_t *g = font6x8[c - 0x20];
    for (int i = 0; i < 6; i++)
        fb[page & 7][x + i] = g[i];   /* 越界由调用方保证 x ≤ 122 */
}

void ssd1306_string(uint8_t x, uint8_t page, const char *s)
{
    while (*s) {
        ssd1306_char(x, page, *s++);
        x += 6;
        if (x > 122) break;
    }
}

void ssd1306_uint(uint8_t x, uint8_t page, uint32_t v)
{
    char buf[11];
    int i = 10;
    buf[i] = '\0';
    if (v == 0) { ssd1306_char(x, page, '0'); return; }
    while (v && i > 0) { buf[--i] = (char)('0' + v % 10); v /= 10; }
    ssd1306_string(x, page, &buf[i]);
}
